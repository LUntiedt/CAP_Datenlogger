## CMakeLists.txt
```
# CAP Datenlogger – Firmware (nRF Connect SDK / Zephyr)
cmake_minimum_required(VERSION 3.20.0)
find_package(Zephyr REQUIRED HINTS $ENV{ZEPHYR_BASE})
project(cap_datenlogger)

target_sources(app PRIVATE
  src/main.c
)
```

## prj.conf
```kconfig
# Grundkonfiguration der Firmware. Optionen mit kurzem Kommentar ergänzen.

# Logging über die serielle Konsole des DK
CONFIG_LOG=y
```

## boards/nrf54l15dk_nrf54l15_cpuapp.overlay
```dts
/*
 * Devicetree-Overlay für den Proof of Concept auf dem nRF54L15 DK.
 * Hier werden die Breakout-Boards (Sensor, Flash) an SPI/I²C und GPIOs angebunden.
 * Ausgefüllt von AP2 (Sensor) und AP3 (Flash).
 */
```

## src/main.c
```c
/*
 * CAP Datenlogger – Einstiegspunkt
 *
 * Firmware-Skelett zum Testen der Toolchain auf dem nRF54L15 DK.
 * Aufbau der Schichten: docs/architecture/firmware.md
 */

#include <zephyr/kernel.h>
#include <zephyr/logging/log.h>

LOG_MODULE_REGISTER(main, LOG_LEVEL_INF);

int main(void)
{
	LOG_INF("CAP Datenlogger: Firmware-Skelett gestartet");

	while (1) {
		k_sleep(K_SECONDS(5));
		LOG_INF("lebt");
	}

	return 0;
}
```
